## boards/shields/fulmen/Kconfig.defconfig
```kconfig
if SHIELD_FULMEN_LEFT

# Name must be less than 16 characters long!
config ZMK_KEYBOARD_NAME
    default "Fulmen"

config ZMK_SPLIT_ROLE_CENTRAL
    default y

endif


if SHIELD_FULMEN_LEFT || SHIELD_FULMEN_RIGHT

config ZMK_SPLIT
    default y

endif

CONFIG_ZMK_POINTING=y
```

## boards/shields/fulmen/Kconfig.shield
```kconfig
config SHIELD_FULMEN_LEFT
    def_bool $(shields_list_contains,fulmen_left)

config SHIELD_FULMEN_RIGHT
    def_bool $(shields_list_contains,fulmen_right)
```
